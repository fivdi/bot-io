/dts-v1/;
/plugin/;

/{
  compatible = "ti,beaglebone", "ti,beaglebone-black";
  part-number = "{{ partNumber }}";
  version = "{{ version }}";

  fragment@0 {
    target = <&epwmss{{ subSystem }}>;
    __overlay__ {
      status = "okay";
    };
  };
};

