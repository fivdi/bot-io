/dts-v1/;
/plugin/;

/ {
  compatible = "ti,beaglebone", "ti,beaglebone-black";
  part-number = "{{ partNumber }}";
  version = "{{ version }}";

  exclusive-use =
    "tscadc";

  fragment@0 {
    target = <&ocp>;
    __overlay__ {
      #address-cells = <1>;
      #size-cells = <1>;

      tscadc {
        compatible = "ti,ti-tscadc";
        reg = <0x44e0d000 0x1000>;

        interrupt-parent = <&intc>;
        interrupts = <16>;
        ti,hwmods = "adc_tsc";
        status = "okay";

        adc {
          ti,adc-channels = <0 1 2 3 4 5 6 7>;
        };
      };
    };
  };
};

